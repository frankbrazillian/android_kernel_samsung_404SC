## arch/arm64/configs/zerolte/variant_jpn_sbm_defconfig
```kconfig
CONFIG_CC_OPTIMIZE_FOR_SIZE=y
CONFIG_BT_BCM4358=yCONFIG_GPS_BCM4773=y
CONFIG_NFC=y
CONFIG_SEC_NFC_SENN3AB=y
CONFIG_SEC_NFC_SENN3AB_FN=y
CONFIG_NFC_DEBUG=y
CONFIG_SEC_NFC_LDO_JPN_CONTROL=y
CONFIG_NFC_EDC_TUNING=y
CONFIG_IPC_ROUTER=y
CONFIG_IPC_ROUTER_SECURITY=y
CONFIG_SENSORS_MAX86902=y
CONFIG_SENSORS_SSP_ATUC128L5HAR=y
CONFIG_SENSORS_SSP_MPU6500=y
CONFIG_SENSORS_SSP_BMP280=y
CONFIG_SENSORS_SSP_TMD4903=y
CONFIG_SENSORS_SSP_AK09911=y
CONFIG_SENSORS_SSP_MOBEAM=y
CONFIG_SENSORS_MAX_NOTCHFILTER=y
CONFIG_SENSORS_SYSFS=y
CONFIG_GPS_BCM4773=y
CONFIG_SENSORS_FINGERPRINT=y
CONFIG_SENSORS_FINGERPRINT_SYSFS=y
CONFIG_SENSORS_VFS7XXX=y
CONFIG_ION_FD2PHYS=y
CONFIG_POWER_SUPPLY=y
CONFIG_POWER_RESET=y
CONFIG_MALI_EXYNOS_TRACE=y
CONFIG_MALI_PLATFORM_THIRDPARTY=y
CONFIG_FUELGAUGE_MAX77843=y
CONFIG_CHARGER_MAX77843=y
CONFIG_SEC_NFC_SENN3AB=y
CONFIG_SEC_NFC_SENN3AB_FN=y
CONFIG_SENSORS_SEC_THERMISTOR=y
CONFIG_THERMAL=y
CONFIG_THERMAL_HWMON=y
CONFIG_THERMAL_OF=y
CONFIG_THERMAL_DEFAULT_GOV_STEP_WISE=y
```
